## Project/cmake-build-debug-zephyr/Kconfig/arch/Kconfig
```kconfig
# Load arch Kconfig descriptions.
osource "/home/flits/zephyrproject/zephyr/arch/x86/Kconfig"
osource "/home/flits/zephyrproject/zephyr/arch/xtensa/Kconfig"
osource "/home/flits/zephyrproject/zephyr/arch/sparc/Kconfig"
osource "/home/flits/zephyrproject/zephyr/arch/riscv/Kconfig"
osource "/home/flits/zephyrproject/zephyr/arch/posix/Kconfig"
osource "/home/flits/zephyrproject/zephyr/arch/nios2/Kconfig"
osource "/home/flits/zephyrproject/zephyr/arch/mips/Kconfig"
osource "/home/flits/zephyrproject/zephyr/arch/arm64/Kconfig"
osource "/home/flits/zephyrproject/zephyr/arch/arm/Kconfig"
osource "/home/flits/zephyrproject/zephyr/arch/arc/Kconfig"
```

## Project/cmake-build-debug-zephyr/Kconfig/soc/Kconfig
```kconfig
# Load Zephyr SoC Kconfig descriptions.
osource "/home/flits/zephyrproject/zephyr/soc/xlnx/zynqmp/Kconfig"
osource "/home/flits/zephyrproject/zephyr/soc/xlnx/zynq7000/Kconfig"
osource "/home/flits/zephyrproject/zephyr/soc/xen/Kconfig"
osource "/home/flits/zephyrproject/zephyr/soc/ti/simplelink/Kconfig"
osource "/home/flits/zephyrproject/zephyr/soc/ti/lm3s6965/Kconfig"
osource "/home/flits/zephyrproject/zephyr/soc/ti/k3/Kconfig"
osource "/home/flits/zephyrproject/zephyr/soc/telink/tlsr/Kconfig"
osource "/home/flits/zephyrproject/zephyr/soc/starfive/jh71xx/Kconfig"
osource "/home/flits/zephyrproject/zephyr/soc/st/stm32/Kconfig"
osource "/home/flits/zephyrproject/zephyr/soc/snps/qemu_arc/Kconfig"
osource "/home/flits/zephyrproject/zephyr/soc/snps/nsim/arc_v/Kconfig"
osource "/home/flits/zephyrproject/zephyr/soc/snps/nsim/arc_classic/Kconfig"
osource "/home/flits/zephyrproject/zephyr/soc/snps/hsdk4xd/Kconfig"
osource "/home/flits/zephyrproject/zephyr/soc/snps/hsdk/Kconfig"
osource "/home/flits/zephyrproject/zephyr/soc/snps/emsk/Kconfig"
osource "/home/flits/zephyrproject/zephyr/soc/snps/emsdp/Kconfig"
osource "/home/flits/zephyrproject/zephyr/soc/snps/arc_iot/Kconfig"
osource "/home/flits/zephyrproject/zephyr/soc/silabs/Kconfig"
osource "/home/flits/zephyrproject/zephyr/soc/sifive/sifive_freedom/Kconfig"
osource "/home/flits/zephyrproject/zephyr/soc/sensry/Kconfig"
osource "/home/flits/zephyrproject/zephyr/soc/rockchip/Kconfig"
osource "/home/flits/zephyrproject/zephyr/soc/renode/riscv_virtual/Kconfig"
osource "/home/flits/zephyrproject/zephyr/soc/renesas/smartbond/Kconfig"
osource "/home/flits/zephyrproject/zephyr/soc/renesas/rzt2m/Kconfig"
osource "/home/flits/zephyrproject/zephyr/soc/renesas/rcar/Kconfig"
osource "/home/flits/zephyrproject/zephyr/soc/renesas/ra/Kconfig"
osource "/home/flits/zephyrproject/zephyr/soc/raspberrypi/Kconfig"
osource "/home/flits/zephyrproject/zephyr/soc/quicklogic/eos_s3/Kconfig"
osource "/home/flits/zephyrproject/zephyr/soc/qemu/virt_riscv/Kconfig"
osource "/home/flits/zephyrproject/zephyr/soc/qemu/malta/Kconfig"
osource "/home/flits/zephyrproject/zephyr/soc/openisa/rv32m1/Kconfig"
osource "/home/flits/zephyrproject/zephyr/soc/nxp/s32/Kconfig"
osource "/home/flits/zephyrproject/zephyr/soc/nxp/rw/Kconfig"
osource "/home/flits/zephyrproject/zephyr/soc/nxp/mcx/Kconfig"
osource "/home/flits/zephyrproject/zephyr/soc/nxp/lpc/Kconfig"
osource "/home/flits/zephyrproject/zephyr/soc/nxp/layerscape/Kconfig"
osource "/home/flits/zephyrproject/zephyr/soc/nxp/kinetis/Kconfig"
osource "/home/flits/zephyrproject/zephyr/soc/nxp/imxrt/Kconfig"
osource "/home/flits/zephyrproject/zephyr/soc/nxp/imx/Kconfig"
osource "/home/flits/zephyrproject/zephyr/soc/nuvoton/numicro/Kconfig"
osource "/home/flits/zephyrproject/zephyr/soc/nuvoton/numaker/Kconfig"
osource "/home/flits/zephyrproject/zephyr/soc/nuvoton/npcx/Kconfig"
osource "/home/flits/zephyrproject/zephyr/soc/nuvoton/npcm/Kconfig"
osource "/home/flits/zephyrproject/zephyr/soc/nordic/Kconfig"
osource "/home/flits/zephyrproject/zephyr/soc/neorv32/Kconfig"
osource "/home/flits/zephyrproject/zephyr/soc/native/inf_clock/Kconfig"
osource "/home/flits/zephyrproject/zephyr/soc/microchip/miv/Kconfig"
osource "/home/flits/zephyrproject/zephyr/soc/microchip/mec/Kconfig"
osource "/home/flits/zephyrproject/zephyr/soc/mediatek/mtk_adsp/Kconfig"
osource "/home/flits/zephyrproject/zephyr/soc/lowrisc/opentitan/Kconfig"
osource "/home/flits/zephyrproject/zephyr/soc/litex/litex_vexriscv/Kconfig"
osource "/home/flits/zephyrproject/zephyr/soc/ite/ec/Kconfig"
osource "/home/flits/zephyrproject/zephyr/soc/intel/raptor_lake/Kconfig"
osource "/home/flits/zephyrproject/zephyr/soc/intel/lakemont/Kconfig"
osource "/home/flits/zephyrproject/zephyr/soc/intel/intel_socfpga_std/Kconfig"
osource "/home/flits/zephyrproject/zephyr/soc/intel/intel_socfpga/Kconfig"
osource "/home/flits/zephyrproject/zephyr/soc/intel/intel_niosv/Kconfig"
osource "/home/flits/zephyrproject/zephyr/soc/intel/intel_ish/Kconfig"
osource "/home/flits/zephyrproject/zephyr/soc/intel/intel_adsp/Kconfig"
osource "/home/flits/zephyrproject/zephyr/soc/intel/elkhart_lake/Kconfig"
osource "/home/flits/zephyrproject/zephyr/soc/intel/atom/Kconfig"
osource "/home/flits/zephyrproject/zephyr/soc/intel/apollo_lake/Kconfig"
osource "/home/flits/zephyrproject/zephyr/soc/intel/alder_lake/Kconfig"
osource "/home/flits/zephyrproject/zephyr/soc/infineon/cat3/Kconfig"
osource "/home/flits/zephyrproject/zephyr/soc/infineon/cat1b/Kconfig"
osource "/home/flits/zephyrproject/zephyr/soc/infineon/cat1a/Kconfig"
osource "/home/flits/zephyrproject/zephyr/soc/gd/gd32/Kconfig"
osource "/home/flits/zephyrproject/zephyr/soc/gaisler/leon3/Kconfig"
osource "/home/flits/zephyrproject/zephyr/soc/gaisler/gr716a/Kconfig"
osource "/home/flits/zephyrproject/zephyr/soc/espressif/Kconfig"
osource "/home/flits/zephyrproject/zephyr/soc/ene/kb1200/Kconfig"
osource "/home/flits/zephyrproject/zephyr/soc/efinix/sapphire/Kconfig"
osource "/home/flits/zephyrproject/zephyr/soc/cdns/xtensa_sample_controller/Kconfig"
osource "/home/flits/zephyrproject/zephyr/soc/cdns/dc233c/Kconfig"
osource "/home/flits/zephyrproject/zephyr/soc/brcm/bcmvk/Kconfig"
osource "/home/flits/zephyrproject/zephyr/soc/brcm/bcm2712/Kconfig"
osource "/home/flits/zephyrproject/zephyr/soc/brcm/bcm2711/Kconfig"
osource "/home/flits/zephyrproject/zephyr/soc/atmel/sam0/Kconfig"
osource "/home/flits/zephyrproject/zephyr/soc/atmel/sam/Kconfig"
osource "/home/flits/zephyrproject/zephyr/soc/aspeed/Kconfig"
osource "/home/flits/zephyrproject/zephyr/soc/arm/Kconfig"
osource "/home/flits/zephyrproject/zephyr/soc/arm/beetle/Kconfig"
osource "/home/flits/zephyrproject/zephyr/soc/andestech/Kconfig"
osource "/home/flits/zephyrproject/zephyr/soc/ambiq/Kconfig"
osource "/home/flits/zephyrproject/zephyr/soc/altr/zephyr_nios2f/Kconfig"
osource "/home/flits/zephyrproject/zephyr/soc/altr/qemu_nios2/Kconfig"
osource "/home/flits/zephyrproject/zephyr/soc/adi/max32/Kconfig"
```
